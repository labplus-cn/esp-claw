## application/edge_agent/boards/labplus/labplus_ledong_max_v1/sdkconfig.defaults.board
```kconfig
CONFIG_APP_CLAW_ENABLE_EMOTE=y
CONFIG_APP_CLAW_LUA_MODULE_AUDIO=y
CONFIG_APP_CLAW_LUA_MODULE_CAMERA=y
CONFIG_APP_CLAW_LUA_MODULE_IMAGE=y
CONFIG_APP_CLAW_LUA_MODULE_VISION=y
CONFIG_APP_CLAW_CAP_LLM_INSPECT=y

CONFIG_ESP_BOARD_PERIPH_I2S_SUPPORT=y
CONFIG_ESP_BOARD_DEV_DISPLAY_LCD_SUPPORT=y
CONFIG_ESP_BOARD_DEV_AUDIO_CODEC_SUPPORT=y
CONFIG_ESP_BOARD_DEV_CAMERA_SUPPORT=y
CONFIG_ESP_BOARD_DEV_CAMERA_SUB_CSI_SUPPORT=y
CONFIG_ESP_BOARD_DEV_FS_FAT_SUPPORT=y
CONFIG_ESP_BOARD_DEV_FS_FAT_SUB_SDMMC_SUPPORT=y

CONFIG_ESP_VIDEO_ENABLE_MIPI_CSI_VIDEO_DEVICE=y
CONFIG_ESP_VIDEO_ENABLE_ISP_PIPELINE_CONTROLLER=y

CONFIG_ESPTOOLPY_FLASHSIZE_16MB=y
CONFIG_ESPTOOLPY_FLASHFREQ_120M=y
CONFIG_SPI_FLASH_HPM_DIS=y
CONFIG_SPI_FLASH_SUPPORT_BOYA_CHIP=y
CONFIG_BOOTLOADER_FLASH_DC_AWARE=y
CONFIG_SPIRAM=y
CONFIG_SPIRAM_MODE_HEX=y
CONFIG_SPIRAM_SPEED_200M=y
CONFIG_CACHE_L2_CACHE_256KB=y
CONFIG_CACHE_L2_CACHE_LINE_128B=y

CONFIG_FREERTOS_TIMER_TASK_STACK_DEPTH=8192
CONFIG_FREERTOS_HZ=1000

CONFIG_CAMERA_SC2336=y
CONFIG_CAMERA_SC2336_MIPI_RAW8_1280x720_30FPS=n
CONFIG_CAMERA_SC2336_MIPI_RAW10_1280x720_30FPS=y

CONFIG_CAMERA_OV2710=y
CONFIG_CAMERA_OV2710_MIPI_RAW10_1280X720_25FPS=y
CONFIG_CAMERA_OV2710_MIPI_RAW10_1920X1080_25FPS=n

# Camera image quality tuning (OV2710)
CONFIG_LUA_MODULE_CAMERA_AE_LEVEL=80
CONFIG_LUA_MODULE_CAMERA_ISP_CONTRAST=58
CONFIG_LUA_MODULE_CAMERA_ISP_BRIGHTNESS=0
CONFIG_LUA_MODULE_CAMERA_ISP_SATURATION=128

CONFIG_CAMERA_OV5645=y
CONFIG_CAMERA_OV5645_MIPI_RGB565_1280X960_30FPS=y
CONFIG_CAMERA_OV5645_MIPI_YUV422_1280X960_30FPS=n

CONFIG_ETHERNET_PHY_IP101=y
CONFIG_ETHERNET_PHY_RST_GPIO=-1

CONFIG_SLAVE_IDF_TARGET_ESP32C5=y
CONFIG_ESP_HOSTED_SDIO_GPIO_RESET_SLAVE=100
```

## components/common/usb_otg/Kconfig
```kconfig
menu "USB OTG Configuration"

    config USB_OTG_MSC
        bool "Enable USB MSC Device mode (SD card as U-disk)"
        default n
        help
            Enable TinyUSB MSC device mode to expose the SD card
            as a USB mass storage device when connected to a PC.

    config USB_OTG_HOST_UVC
        bool "Enable USB Host UVC mode (USB camera)"
        default n
        help
            Enable USB Host mode with UVC camera support.
            Allows connecting a USB camera to the OTG port.

    config USB_OTG_MSC_TASK_STACK_SIZE
        int "TinyUSB device task stack size"
        depends on USB_OTG_MSC
        default 4096
        help
            Stack size for the TinyUSB device task.

    config USB_OTG_HOST_TASK_STACK_SIZE
        int "USB Host task stack size"
        depends on USB_OTG_HOST_UVC
        default 4096
        help
            Stack size for the USB Host library task.

endmenu
```

## components/lua_modules/lua_module_camera/Kconfig
```kconfig
menu "Lua Camera Module"
    depends on APP_CLAW_CAP_LUA
    depends on APP_CLAW_LUA_MODULE_CAMERA

    config LUA_MODULE_CAMERA_ENABLE_VFLIP
        bool "Camera vertical flip"
        default y
        help
            Set V4L2_CID_VFLIP to 1 when enabled or 0 when disabled whenever
            camera.open() starts a camera stream.

    config LUA_MODULE_CAMERA_ENABLE_HMIRROR
        bool "Camera horizontal mirror"
        default n
        help
            Set V4L2_CID_HFLIP to 1 when enabled or 0 when disabled whenever
            camera.open() starts a camera stream.

    config LUA_MODULE_CAMERA_AE_LEVEL
        int "AE target level (lower=darker, range 2-235, sensor default 48)"
        range 2 235
        default 48
        help
            Auto-exposure target brightness level (V4L2_CID_CAMERA_AE_LEVEL).
            Lower values produce darker images, higher values brighter.
            Sensor default is 48. Set to 48 to skip this control.

    menu "ISP Image Quality (applied after stream start)"
        depends on ESP_VIDEO_ENABLE_ISP_PIPELINE_CONTROLLER

        config LUA_MODULE_CAMERA_ISP_CONTRAST
            int "Contrast (0-255, 128=neutral)"
            range 0 255
            default 128
            help
                ISP contrast via /dev/video20. Higher values increase the
                difference between light and dark areas. 128 is neutral.

        config LUA_MODULE_CAMERA_ISP_BRIGHTNESS
            int "Brightness (-128 to 127, 0=neutral)"
            range -128 127
            default 0
            help
                ISP brightness offset via /dev/video20. Positive values make
                the image brighter, negative values darker. 0 is neutral.

        config LUA_MODULE_CAMERA_ISP_SATURATION
            int "Saturation (0-255, 128=neutral)"
            range 0 255
            default 128
            help
                ISP color saturation via /dev/video20. Higher values make
                colors more vivid, lower values more washed out. 128 is neutral.

    endmenu

endmenu
```

## components/lua_modules/lua_module_environmental_sensor/Kconfig
```kconfig
menu "Lua Environmental Sensor Module"

    config LUA_MODULE_ENVIRONMENTAL_SENSOR_BACKEND_BME690
        bool "Enable BME690 backend"
        default y
        help
            Build the environmental sensor Lua module with the Bosch BME690
            backend.

    config LUA_MODULE_ENVIRONMENTAL_SENSOR_BACKEND_DHT
        bool "Enable DHT backend"
        default y
        help
            Build the environmental sensor Lua module with the DHT-family
            single-wire backend.

    config LUA_MODULE_ENVIRONMENTAL_SENSOR_BACKEND_LTR308ALS
        bool "Enable LTR-308ALS ambient light sensor backend"
        default y
        help
            Build the environmental sensor Lua module with the LTR-308ALS
            ambient light sensor backend.

    config LUA_MODULE_ENVIRONMENTAL_SENSOR_BACKEND_SPL06
        bool "Enable SPL06-001 barometric pressure sensor backend"
        default y
        help
            Build the environmental sensor Lua module with the SPL06-001
            barometric pressure sensor backend.

endmenu
```
